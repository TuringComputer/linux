/*
 * Copyright (C) 2016 Turing Computer.
 */
/dts-v1/;

#include "imx6q-turing.dtsi"
#include "imx6qdl-turing-eval.dtsi"

/ {
	model = "Turing i.MX6 Evaluation Board Dual/Quad";
	compatible = "turing,imx6q-turing", "fsl,imx6q";
	
	mxcfb1: fb@0 {
		compatible = "fsl,mxc_sdc_fb";
		disp_dev = "lcd";
		interface_pix_fmt = "RGB24";
		mode_str ="1280x720M@60";
		default_bpp = <24>;
		int_clk = <0>;
		late_init = <0>;
		status = "okay"; 
	};

	mxcfb2: fb@1 {
		compatible = "fsl,mxc_sdc_fb";
		disp_dev = "ldb";
		interface_pix_fmt = "RGB666";
		default_bpp = <16>;
		int_clk = <0>;
		late_init = <0>;
		status = "okay";
	};
};

&sata {
	fsl,transmit-level-mV = <1025>;
	fsl,transmit-boost-mdB = <3330>;
	fsl,transmit-atten-16ths = <9>;
	fsl,receive-eq-mdB = <3000>;
	fsl,no-spread-spectrum = <0>;
};
