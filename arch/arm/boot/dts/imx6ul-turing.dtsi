/*
 * Copyright (C) 2017 Turing Computer.
 */

#include <dt-bindings/input/input.h>
#include "imx6ul.dtsi"
#include "imx6ux-turing.dtsi"

&iomuxc {
	pinctrl-names = "default";
	pinctrl-0 = <&pinctrl_hog_1>;

	imx6ul-turing {

		pinctrl_hog_1: hoggrp-1 { /* GPIO */
            fsl,pins = <
            	MX6UL_PAD_JTAG_MOD__GPIO1_IO10 			0x1b0b0			/* GPIO00 PIN 045 as GPIO(1, 10)   */
				MX6UL_PAD_JTAG_TMS__GPIO1_IO11 			0x1b0b0			/* GPIO01 PIN 092 as GPIO(1, 11)   */
				MX6UL_PAD_UART1_RTS_B__GPIO1_IO19		0x1b0b0			/* GPIO02 PIN 043 as GPIO(1, 19)   */
				MX6UL_PAD_ENET1_TX_DATA1__GPIO2_IO04	0x1b0b0			/* GPIO03 PIN 142 as GPIO(2, 4)    */
				MX6UL_PAD_SNVS_TAMPER0__GPIO5_IO00      0x1b0b0			/* GPIO06 PIN 121 as GPIO(5, 0)    */
                MX6UL_PAD_SNVS_TAMPER1__GPIO5_IO01		0x1b0b0			/* GPIO07 PIN 160 as GPIO(5, 1)    */
				MX6UL_PAD_SNVS_TAMPER2__GPIO5_IO02		0x1b0b0			/* GPIO09 PIN 139 as GPIO(5, 2)    */
				MX6UL_PAD_SNVS_TAMPER4__GPIO5_IO04		0x1b0b0			/* GPIO10 PIN 017 as GPIO(5, 4)    */
				MX6UL_PAD_SNVS_TAMPER5__GPIO5_IO05		0x1b0b0			/* GPIO11 PIN 117 as GPIO(5, 5)    */
				MX6UL_PAD_ENET1_RX_DATA1__GPIO2_IO01	0x1b0b0			/* GPIO12 PIN 140 as GPIO(2, 1)    */
				MX6UL_PAD_ENET1_RX_ER__GPIO2_IO07		0x1b0b0			/* GPIO13 PIN 134 as GPIO(2, 7)    */
				MX6UL_PAD_ENET2_RX_DATA1__GPIO2_IO09	0x1b0b0			/* GPIO14 PIN 162 as GPIO(2, 9)    */
				MX6UL_PAD_ENET2_RX_DATA0__GPIO2_IO08	0x1b0b0			/* GPIO15 PIN 122 as GPIO(2, 8)    */
				MX6UL_PAD_ENET1_RX_DATA0__GPIO2_IO00	0x1b0b0			/* GPIO16 PIN 157 as GPIO(2, 0)    */
				MX6UL_PAD_SNVS_TAMPER9__GPIO5_IO09		0x1b0b0			/* GPIO17 PIN 141 as GPIO(5, 9)    */
				MX6UL_PAD_SNVS_TAMPER6__GPIO5_IO06		0x1b0b0			/* GPIO19 PIN 124 as GPIO(5, 6)    */
				MX6UL_PAD_SNVS_TAMPER7__GPIO5_IO07		0x1b0b0			/* GPIO20 PIN 146 as GPIO(5, 7)    */
				MX6UL_PAD_ENET1_TX_DATA0__GPIO2_IO03	0x1b0b0			/* GPIO21 PIN 148 as GPIO(2, 3)    */
				MX6UL_PAD_ENET1_TX_EN__GPIO2_IO05		0x1b0b0			/* GPIO22 PIN 133 as GPIO(2, 5)    */
				MX6UL_PAD_GPIO1_IO00__GPIO1_IO00		0x1b0b0			/* GPIO23 PIN 119 as GPIO(1, 0)    */
				MX6UL_PAD_GPIO1_IO01__GPIO1_IO01		0x1b0b0			/* GPIO24 PIN 163 as GPIO(1, 1)    */
				MX6UL_PAD_ENET1_TX_CLK__GPIO2_IO06		0x1b0b0			/* GPIO25 PIN 164 as GPIO(2, 6)    */
				MX6UL_PAD_SNVS_TAMPER8__GPIO5_IO08		0x1b0b0			/* GPIO27 PIN 159 as GPIO(5, 8)    */
        		MX6UL_PAD_ENET2_RX_ER__GPIO2_IO15		0x1b0b0			/* SDIO1 WP PIN 077 as GPIO(2, 15) */
				MX6UL_PAD_LCD_RESET__GPIO3_IO04			0x1b0b0			/* SDIO1 CD PIN 120 as GPIO(3, 4)  */
                MX6UL_PAD_UART1_CTS_B__GPIO1_IO18		0x1b0b0			/* TOUCHSCREEN INT as GPIO(1, 18)  */
                MX6UL_PAD_CSI_DATA05__GPIO4_IO26		0x1b0b0			/* OTG VBUS PWR EN as GPIO(4, 26)  */
                MX6UL_PAD_ENET1_RX_EN__REF_CLK_32K		0x1b0b0			/* 32 KHZ Output                   */
            >;
        };
        
        pinctrl_dvfs: dvfsgrp {
            fsl,pins = <
                MX6UL_PAD_SNVS_TAMPER3__GPIO5_IO03      0x79
            >;
        };
        		
	};
};

