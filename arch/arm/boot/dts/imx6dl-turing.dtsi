/*
 * Copyright (C) 2016 Turing Computer.
 */

#include "imx6dl.dtsi"
#include "imx6qdl-turing.dtsi"

/ {
	reserved-memory {
		#address-cells = <1>;
		#size-cells = <1>;
		ranges;

		/* global autoconfigured region for contiguous allocations */
		linux,cma {
			compatible = "shared-dma-pool";
			reusable;
			size = <0x10000000>;		// 256M
			linux,cma-default;
		};
	};
};