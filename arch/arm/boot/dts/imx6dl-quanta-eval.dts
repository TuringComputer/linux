/*
 * Copyright (C) 2015 Quanta Tecnologia Eletronica, LTDA.
 */
/dts-v1/;

#include "imx6dl-quanta.dtsi"
#include "imx6qdl-quanta-eval.dtsi"

/ {
	model = "Quanta i.MX6 Evaluation Board Dual/Quad";
	compatible = "quanta,eval/q", "fsl,imx6q";
};
